## code/ch19-wireless/esp32-idf/main/Kconfig.projbuild
```kconfig
menu "Example configuration"

    config EXAMPLE_WIFI_SSID
        string "Wi-Fi SSID"
        default "your-ssid"

    config EXAMPLE_WIFI_PASSWORD
        string "Wi-Fi password"
        default "your-password"

    config EXAMPLE_HTTP_URL
        string "URL to GET"
        default "http://example.com/"

endmenu
```

## code/ch20-iot/esp32-idf/main/Kconfig.projbuild
```kconfig
menu "Example configuration"

    config EXAMPLE_WIFI_SSID
        string "Wi-Fi SSID"
        default "your-ssid"

    config EXAMPLE_WIFI_PASSWORD
        string "Wi-Fi password"
        default "your-password"

    config EXAMPLE_BROKER_URI
        string "MQTT broker URI"
        default "mqtt://192.168.0.10"
        help
            같은 네트워크의 PC에서 Mosquitto를 실행하고 그 PC의 IP를 넣는다.
            TLS를 쓰려면 mqtts://호스트:8883 형식과 CA 인증서가 필요하다(20.5절).

endmenu
```

## code/ch32-bootloader/esp32-ota/main/Kconfig.projbuild
```kconfig
menu "Example configuration"

    config EXAMPLE_WIFI_SSID
        string "Wi-Fi SSID"
        default "your-ssid"

    config EXAMPLE_WIFI_PASSWORD
        string "Wi-Fi password"
        default "your-password"

    config EXAMPLE_OTA_URL
        string "Firmware URL"
        default "http://192.168.0.10:8000/ch32-ota.bin"
        help
            같은 네트워크의 PC에서 build 폴더로 가서 python3 -m http.server 8000 을 실행하고
            그 PC의 IP를 넣는다. 제품에서는 https:// 와 서버 인증서를 쓴다.

    config EXAMPLE_SIMULATE_BAD_IMAGE
        bool "Make the self-test fail (rollback demo)"
        default n
        help
            켜고 빌드한 이미지는 자가 진단에 실패해 스스로 롤백한다.

endmenu
```

## code/ch40-sensor-node/esp32-bridge/main/Kconfig.projbuild
```kconfig
menu "Example configuration"
    config EXAMPLE_WIFI_SSID
        string "Wi-Fi SSID"
        default "your-ssid"
    config EXAMPLE_WIFI_PASSWORD
        string "Wi-Fi password"
        default "your-password"
    config EXAMPLE_BROKER_URI
        string "MQTT broker URI (mqtts://host:8883)"
        default "mqtts://192.168.0.10:8883"
    config EXAMPLE_NODE_ID
        string "Node ID used in MQTT topics"
        default "node-001"
endmenu
```
